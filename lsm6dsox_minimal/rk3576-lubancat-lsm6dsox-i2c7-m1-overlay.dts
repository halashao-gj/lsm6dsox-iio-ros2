/dts-v1/;
/plugin/;

/ {
	fragment@0 {
		target = <&i2c7>;

		__overlay__ {
			status = "okay";
			pinctrl-names = "default";
			pinctrl-0 = <&i2c7m1_xfer>;
			#address-cells = <1>;
			#size-cells = <0>;

			lsm6dsox-minimal@6a {
				compatible = "study,lsm6dsox-minimal";
				reg = <0x6a>;
				interrupt-parent = <&gpio0>;
				interrupts = <21 1>;
				status = "okay";
			};
		};
	};
};
